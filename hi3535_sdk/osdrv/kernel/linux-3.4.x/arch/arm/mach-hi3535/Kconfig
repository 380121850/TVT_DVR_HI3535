## hi3535_sdk/osdrv/kernel/linux-3.4.x/arch/arm/mach-hi3535/Kconfig
```kconfig
menu "HI3535 board feature"

config MACH_HI3535
	bool "Support hi3535 platform"
	select CPU_V7
	select ARM_GIC
	select ARM_TIMER_SP804
	help
	  Include support for the hisilion HI3535 platform.
	  HI3535 support ARM CORTEX-A9 processer,
	  within a Generic Interrupt Controller.
	  Support DDR2 and DDR3.
choice
        prompt "CPU timer source"
        default HAVE_SP804_LOCAL_TIMER

config HAVE_SP804_LOCAL_TIMER
	bool "arm local timer from sp804"
	help
	  arm local timer from sp804.
	  if you choice sp804 as local timer,
	  please select HAVE_SP804_LOCAL_TIMER,
	  if you choice arm selt as local timer,
	  please select HAVE_ARM_LOCAL_TIMER.

config HAVE_ARM_LOCAL_TIMER
	bool "arm local timer from arm self"
	help
	  arm local timer from arm self.
	  if you choice sp804 as local timer,
	  please select HAVE_SP804_LOCAL_TIMER,
	  if you choice arm selt as local timer,
	  please select HAVE_ARM_LOCAL_TIMER.

endchoice

config DEFAULT_BUSCLK
	int "DEFAULT_BUSCLK"
	default "50000000"
	help
	  Default AHB clock rate

endmenu

menu "Hi3535 SoC in Synology's options"
    depends on MACH_HI3535

config SYNO_HI3535_NVR
    bool "synology hi3535 NVR porting define"
    default y
    depends on MACH_HI3535
    select ARCH_REQUIRE_GPIOLIB

config SYNO_HI3535_VS
    bool "synology hi3535 vs porting define"
    default y
    depends on MACH_HI3535

config SYNO_MAC_ADDRESS
    bool "read synology mac address from nand flash"
    default y
    depends on SYNO_HI3535_VS || SYNO_HI3535_NVR
 	---help---
	read mac address from "vender" partition within nand flash

config SYNO_MAC_IF
	int "number of available network interface"
	default 1
	depends on SYNO_MAC_ADDRESS
	---help---
    available network interface on this system

config SYNO_SERIAL
    bool "read synology serial number from nand flash"
    default y
    depends on SYNO_HI3535_VS || SYNO_HI3535_NVR
	 ---help---
	read serial number from "vender" partition within nand flash

config SYNO_FACTORY_USB3_DISABLE
	bool "Temporarily disable the USB3 function of USB3 port"
	default y
	depends on SYNO_HI3535_VS || SYNO_HI3535_NVR
	---help---
	For Factory production purpose , disable USB3 function of USB3 port

config SYNO_SKIP_RXDROP_BY_CORE
	bool "Fix RX packets drop is increasing"
	default y
	depends on SYNO_HI3535_VS || SYNO_HI3535_NVR
	---help---
	Fix: Linux-2.6.38 #241 RX packets drop is increasing
	Dsc: rx_dropped counts packets dropped by driver "and kernel core"
	this define will let it only record the packets dropped by driver
	please refer to caf586e5, 8990f468a

config HI3535_SDK_2050
	bool "using enable Hi3535 SDK 2.0.50 patch"
	default y
	depends on SYNO_HI3535_VS || SYNO_HI3535_NVR
	---help---
	apply hi3535 SDK 2.0.50 patch 

endmenu
```

## hi3535_sdk/osdrv/kernel/linux-3.4.x/synoconfigs/Kconfig
```kconfig
# description of the syntax of this configuration file,
# see Documentation/kbuild/kconfig-language.txt.
#

menu "Synology special config"

config SYNO_LP3943_FEATURES
	bool "Customized features of LP3943 led dirver for Synology Corp. NAS product"
	depends on LEDS_LP3943
	default n

config SYNO_FORCE_EH_FULL_RECOVER_RETRY
        bool "Force to reset all links of a PMP while retrying EH recover"
        default y

config SYNO_DISPLAY_CPUINFO
    bool "Support display CPU Infomation"

config SYNO_GPIO_DEVICE
	depends on SYNO_HI3535_NVR
	bool "add a fake gpio device for gpio library."

config SYNO_I2C_DEVICE
	depends on SYNO_HI3535_NVR && SYNO_GPIO_DEVICE
	bool "enable I2C by GPIO simulated"

config SYNO_FIX_THERMAL_SENSOR
	depends on SYNO_I2C_DEVICE
	bool "fix LM75 nack issue"

config SYNO_HI3535_SUPPORT_WOL
	bool "Enable Wake On LAN on hi3535 platform"
	default y
	depends on SYNO_HI3535_NVR

config SYNO_HI3535_SW_SATA_LED
	bool "Enable software SATA LED"
	default y
	depends on SYNO_HI3535_NVR

config SYNO_LP3943_REVERSE_BRIGHTNESS
	bool "Reverse brightness setting"
	depends on SYNO_LP3943_FEATURES
	default y

config SYNO_ENABLE_USBFS_ENTRY
	bool "Add USB entry to /proc/bus"
	default y

config SYNO_INCREASE_SKB_SIZE
	bool "Increase skb size to 2K"
	default y
	depends on SYNO_HI3535_NVR

endmenu
```

## hi3535_sdk/osdrv/kernel/linux-3.4.y/drivers/usb/host/Kconfig.hiusb2_0
```kconfig
#
# hiusb Host Controller Drivers
#
comment "hiusb(ehci/ohci) Host Controller Drivers"
	depends on USB

menuconfig HIUSB_HOST2_0
	bool "hiusb(ehci/ohci) family usb host device support"
	depends on ARCH_HI3535
	default y if ARCH_HI3535
	select USB
	select USB_ARCH_HAS_EHCI
	select USB_ARCH_HAS_OHCI
	help
          This selects the usb(ehci/ohci) family usb host device.
	  Say Y to enable hisi usb2.0 controller driver.
	  IF you do not use usb2.0 device in your board, say N to get a
	  smaller uImage. Mostly you need it.

if HIUSB_HOST2_0

config HIUSB_EHCI
	bool "hiusb-ehci usb host device support"
	depends on ARCH_HI3535
	default y if ARCH_HI3535
	help
	  Enable hisi ehci controller driver.
	  Say Y to enable hisi usb2.0 ehci controller driver.
	  IF you do not use usb2.0 ehci device in your board, say N to get a
	  smaller uImage. Mostly you need it.

config HIUSB_EHCI_IOBASE
	hex "hiusb-ehci IO address"
	default "0x10040000" if ARCH_HI3535

config HIUSB_EHCI_IOSIZE
	hex "hiusb-ehci IO size"
	default "0x00010000"
	help
	  default is 0x10000.

config HIUSB_EHCI_IRQNUM
	int "hiusb-ehci irq number"
	default "54" if ARCH_HI3535
	help
	  Please use the default value in this Kconfig, The default value
	  is the right value provided by hisi.

config HIUSB_OHCI
	bool "hiusb-ohci usb host device support"
	depends on ARCH_HI3535
	default y if ARCH_HI3535
	help
	  Enable hisi ohci controller driver.
	  Say Y to enable hisi usb2.0 ohci controller driver.
	  IF you do not use usb2.0 ohci device in your board, say N to get a
	  smaller uImage. Mostly you need it.

config HIUSB_OHCI_IOBASE
	hex "hiusb-ohci IO address"
	default "0x10030000" if ARCH_HI3535

config HIUSB_OHCI_IOSIZE
	hex "hiusb-ohci IO size"
	default "0x00010000"
	help
	  default is 0x10000.

config HIUSB_OHCI_IRQNUM
	int "hiusb-ohci irq number"
	default "53" if ARCH_HI3535
	help
	  Please use the default value in this Kconfig, The default value
	  is the right value provided by hisi.
endif # HIUSB_HOST

#vim: set ts=8 sw=8 tw=78:
```
